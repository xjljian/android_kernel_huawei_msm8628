/* overlay msm8226.dtsi */
&soc {
	qcom,msm-mem-hole {
		compatible = "qcom,msm-mem-hole";
		qcom,memblock-remove = <0x08400000 0x4000000
					0x0d200000 0x2300000
					0x0fa00000 0x500000
                                        0x12d00000 0x100000>; /* Address and Size of Hole */
        };
     };
