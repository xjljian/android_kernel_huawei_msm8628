 &soc {
	qcom,spmi@fc4c0000 {
		qcom,pm8226@1 {
			qcom,vibrator@c000 {
				compatible = "qcom,qpnp-vibrator";
				qcom,vib-timeout-ms = <15000>;
				qcom,vib-vtg-level-mV = <3100>;
				reg = <0xc000 0x100>;
				label = "vibrator";
				status = "ok";
			};
		};
	};
};
